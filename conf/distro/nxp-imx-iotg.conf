## conf/distro/nxp-imx-iotg.conf
```bitbake
DISTRO = "nxp-imx-iotg"

require conf/distro/fsl-imx-fb.conf

DISTRO_FEATURES_append = " pam systemd pulseaudio alsa"

# Using systemd, but not setting DISTRO_FEATURES_BACKFILL_CONSIDERED
# to "sysvinit" because it removes /etc/network/interfaces, whose presence we need
# to prevent NetworkManager from trying to control the AP on wlan0
VIRTUAL-RUNTIME_init_manager = "systemd"

IMAGE_ROOTFS_EXTRA_SPACE = "3145728"
```

## conf/layer.conf
```bitbake
# We have a conf and classes directory, add to BBPATH
BBPATH .= ":${LAYERDIR}"

# We have a packages directory, add to BBFILES
BBFILES += "${LAYERDIR}/recipes-*/*/*.bb \
            ${LAYERDIR}/recipes-*/*/*.bbappend"

BBFILE_COLLECTIONS += "nxp-iotg"
BBFILE_PATTERN_nxp-iotg := "^${LAYERDIR}"
BBFILE_PRIORITY_nxp-iotg = "8"
```
